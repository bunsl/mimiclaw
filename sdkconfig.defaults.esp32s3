## sdkconfig.defaults.esp32s3
```kconfig
# MimiClaw - ESP32-S3 Target Configuration
CONFIG_IDF_TARGET="esp32s3"

# Flash 16MB + QIO
CONFIG_ESPTOOLPY_FLASHSIZE_16MB=y
CONFIG_ESPTOOLPY_FLASHMODE_QIO=y

# CPU 240MHz
CONFIG_ESP_DEFAULT_CPU_FREQ_MHZ_240=y

# PSRAM 8MB Octal
CONFIG_SPIRAM=y
CONFIG_SPIRAM_MODE_OCT=y
CONFIG_SPIRAM_SPEED_80M=y
CONFIG_SPIRAM_MALLOC_ALWAYSINTERNAL=2048
CONFIG_SPIRAM_MALLOC_RESERVE_INTERNAL=98304
CONFIG_SPIRAM_MEMTEST=n

# WiFi memory optimization
CONFIG_ESP_WIFI_STATIC_RX_BUFFER_NUM=3
CONFIG_ESP_WIFI_DYNAMIC_RX_BUFFER_NUM=6
CONFIG_ESP_WIFI_RX_BA_WIN=3
# Pin WiFi task to core 1 to avoid priority starvation by esp_timer/sys_event on core 0
# esp_wifi_init() blocks on a semaphore; if the WiFi task is starved, main task watchdog fires
CONFIG_ESP_WIFI_TASK_PINNED_TO_CORE_1=y
CONFIG_LWIP_TCPIP_RECVMBOX_SIZE=16

# TLS optimization (PSRAM allocation + small buffers)
CONFIG_MBEDTLS_EXTERNAL_MEM_ALLOC=y
CONFIG_MBEDTLS_DYNAMIC_FREE_CONFIG_DATA=y
CONFIG_MBEDTLS_SSL_IN_CONTENT_LEN=16384
CONFIG_MBEDTLS_SSL_OUT_CONTENT_LEN=4096

# WebSocket support
CONFIG_HTTPD_WS_SUPPORT=y
CONFIG_LV_BUILD_EXAMPLES=n
CONFIG_LV_BUILD_DEMOS=n

# Custom partition table
CONFIG_PARTITION_TABLE_CUSTOM=y
CONFIG_PARTITION_TABLE_CUSTOM_FILENAME="partitions.csv"

# Console: UART primary (non-blocking), USB Serial/JTAG secondary
# Prevents device hang when no USB host is connected (issue #60)
CONFIG_ESP_CONSOLE_UART_DEFAULT=y
CONFIG_ESP_CONSOLE_SECONDARY_USB_SERIAL_JTAG=y

# Startup stack headroom for display + LVGL init on ESP32-S3
CONFIG_ESP_MAIN_TASK_STACK_SIZE=8192
CONFIG_ESP_INT_WDT_TIMEOUT_MS=1500
```
